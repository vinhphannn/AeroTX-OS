## sdkconfig.defaults
```kconfig
# Enable Bluetooth (NimBLE)
CONFIG_BT_ENABLED=y
CONFIG_BT_NIMBLE_ENABLED=y
CONFIG_BT_CONTROLLER_ENABLED=y

# NimBLE Security & Bonding (Required for Windows 11 HID)
CONFIG_BT_NIMBLE_NVS_PERSIST=y
CONFIG_BT_NIMBLE_MAX_BONDS=5
CONFIG_BT_NIMBLE_SM_SC=y
CONFIG_BT_NIMBLE_SECURITY_ENABLE=y

# Memory optimization for NimBLE
CONFIG_BT_NIMBLE_HOST_TASK_STACK_SIZE=5120
CONFIG_BT_NIMBLE_MEM_ALLOC_MODE_INTERNAL=y

# UI Smoothness (LVGL Timer performance)
CONFIG_FREERTOS_HZ=1000

# Enable ESP HID Device
CONFIG_ESP_HIDD_ENABLED=y
CONFIG_ESP_HIDD_BLE_TRANSPORT=y
```
